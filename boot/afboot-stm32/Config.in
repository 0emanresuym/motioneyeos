## boot/afboot-stm32/Config.in
```kconfig
config BR2_TARGET_AFBOOT_STM32
	bool "afboot-stm32"
	depends on BR2_arm
	help
	  afboot-stm32 is a very small bootloader for STM32 platforms

	  https://github.com/mcoquelin-stm32/afboot-stm32
diff --git a/package/rpi-firmware/Config.in b/package/rpi-firmware/Config.in
index c2983aa..49f25da 100644
--- a/package/rpi-firmware/Config.in
+++ b/package/rpi-firmware/Config.in
@@ -58,8 +58,9 @@ config BR2_PACKAGE_RPI_FIRMWARE_INSTALL_DTBS

 config BR2_PACKAGE_RPI_FIRMWARE_INSTALL_DTB_OVERLAYS
        bool "Install DTB overlays"
-       depends on BR2_PACKAGE_RPI_FIRMWARE_INSTALL_DTBS \
-               || BR2_LINUX_KERNEL_DTS_SUPPORT
+       depends on (BR2_PACKAGE_RPI_FIRMWARE_INSTALL_DTBS \
+               || BR2_LINUX_KERNEL_DTS_SUPPORT) && \
+               !BR2_LINUX_KERNEL_DTS_OVERLAYS_SUPPORT
        default y
        help
          Say 'y' here if you need to load one or more of the DTB overlays,
```
